## Kconfig.projbuild
```kconfig
menu "Simple Async UDP Listener"

choice LOG_LOCAL_LEVEL_ASYNC_UDP_LISTENER
    bool "ASYNC_UDP_LISTENER log verbosity"
    default LOG_LOCAL_LEVEL_ASYNC_UDP_LISTENER_INFO
    help
        Specify how much output to compile into the binary.
        You can set lower verbosity level at runtime using
        esp_log_level_set function.

        Note that this setting limits which log statements
        are compiled into the program. So setting this to,
        say, "Warning" would mean that changing log level
        to "Debug" at runtime will not be possible.

    config LOG_LOCAL_LEVEL_ASYNC_UDP_LISTENER_NONE
        bool "No output"
    config LOG_LOCAL_LEVEL_ASYNC_UDP_LISTENER_ERROR
        bool "Error"
    config LOG_LOCAL_LEVEL_ASYNC_UDP_LISTENER_WARN
        bool "Warning"
    config LOG_LOCAL_LEVEL_ASYNC_UDP_LISTENER_INFO
        bool "Info"
    config LOG_LOCAL_LEVEL_ASYNC_UDP_LISTENER_DEBUG
        bool "Debug"
    config LOG_LOCAL_LEVEL_ASYNC_UDP_LISTENER_VERBOSE
        bool "Verbose"
endchoice

config LOG_LOCAL_LEVEL_ASYNC_UDP_LISTENER
    int
    default 0 if LOG_LOCAL_LEVEL_ASYNC_UDP_LISTENER_NONE
    default 1 if LOG_LOCAL_LEVEL_ASYNC_UDP_LISTENER_ERROR
    default 2 if LOG_LOCAL_LEVEL_ASYNC_UDP_LISTENER_WARN
    default 3 if LOG_LOCAL_LEVEL_ASYNC_UDP_LISTENER_INFO
    default 4 if LOG_LOCAL_LEVEL_ASYNC_UDP_LISTENER_DEBUG
    default 5 if LOG_LOCAL_LEVEL_ASYNC_UDP_LISTENER_VERBOSE

endmenu
```
